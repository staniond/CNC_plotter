## main/Kconfig.projbuild
```kconfig
menu "WiFi configuration"

    config WIFI_SSID
        string "WiFi SSID"
        default "myssid"
        help
            SSID (network name) to connect to.

    config WIFI_PASS
        string "WiFi password"
        default "mypassword"
        help
            WiFi password (WPA or WPA2) to use.

    config TCP_PORT
        int "TCP server port"
        default 8888
        help
            TCP port to use when creating the server socket.
endmenu
```
